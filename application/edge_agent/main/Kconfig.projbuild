## application/edge_agent/main/Kconfig.projbuild
```kconfig
menu "App Config"

menu "Default Wi-Fi Settings"

    config APP_WIFI_SSID
        string "Default Wi-Fi SSID"
        default ""
        help
            Default Wi-Fi SSID used to populate app settings.

    config APP_WIFI_PASSWORD
        string "Default Wi-Fi password"
        default ""
        help
            Default Wi-Fi password used to populate app settings.

    config APP_WIFI_AP_SSID_PREFIX
        string "Provisioning AP SSID prefix"
        default "KrakBot-Nano"
        help
            Prefix used to build the unique provisioning AP SSID. The full
            SSID is "<prefix>-<MAC[3..5]>" (e.g. KrakBot-Nano-84AEE5).

    config APP_WIFI_AP_PASSWORD
        string "Default provisioning AP password"
        default "KrakBotNano2026"
        help
            WPA2 password used for the provisioning SoftAP when the user
            has not set a custom ap_password in app config. Must be 8-63
            characters; the AP is never left open. Change this per-device
            via the web config UI for stronger security.

    config APP_WIFI_AP_CHANNEL
        int "Provisioning AP channel"
        range 1 13
        default 1
        help
            Channel used by the provisioning SoftAP.

    config APP_WIFI_AP_MAX_CONN
        int "Provisioning AP max connections"
        range 1 10
        default 4
        help
            Maximum number of concurrent stations on the provisioning AP.

    config APP_WIFI_MAX_RETRY
        int "STA max retries before AP fallback"
        range 1 20
        default 5
        help
            After this many consecutive STA connection failures the device
            falls back to pure AP mode and waits for the user to provision
            new credentials.

endmenu

menu "Local HTTP Config API"

    config APP_HTTP_ADMIN_PASSWORD
        string "Local config/API HTTP Basic Auth password"
        default "KrakBotNano2026"
        help
            HTTP Basic Auth password (username: admin) required to reach
            the local config/status/files API endpoints, which expose
            secrets such as the Wi-Fi password and LLM/IM API keys. Must
            be 8-63 characters; unlike ap_password this can never be
            empty. Change this per-device via the web config UI.

endmenu

menu "Default Search Settings"

    config APP_SEARCH_HTTP_ALLOWLIST
        string "Default HTTP Request allowlist"
        default "*"
        help
            Default value used to populate app setting `search_http_allowlist`.
            Use `*` to allow all hosts, or a comma-separated list of domains/IPs.

            e.g. "api.example.com,*.example.org,203.0.113.10"

endmenu

endmenu
```

## components/claw_capabilities/cap_activity_log/Kconfig.projbuild
```kconfig
menu "Activity log (cap_activity_log)"

config CAP_ACTIVITY_LOG_MAX_BYTES
    int "Max size of one activity log segment (bytes)"
    default 131072
    range 16384 1048576
    help
        The log keeps two segments (activity.jsonl and activity.1.jsonl).
        Worst case disk usage is 2 x this value. The smallest DATA partition
        (8 MB boards) is 1664 KB, so the default of 128 KB uses at most 256 KB.

config CAP_ACTIVITY_LOG_FLUSH_INTERVAL_MS
    int "Flush interval (ms)"
    default 60000
    range 5000 600000
    help
        Pending entries are written to flash at most this often.

config CAP_ACTIVITY_LOG_FLUSH_BATCH
    int "Flush batch (entries)"
    default 16
    range 1 128
    help
        A flush is triggered as soon as this many entries are pending.

config CAP_ACTIVITY_LOG_BUFFER_ENTRIES
    int "In-RAM buffer size (entries)"
    default 32
    range 4 256
    help
        Must be >= CAP_ACTIVITY_LOG_FLUSH_BATCH (otherwise the batch is
        clamped to this value). When the buffer is full the oldest pending
        entry is dropped and counted in the "dropped" statistic.

config CAP_ACTIVITY_LOG_FLUSH_ON_ERROR
    bool "Flush immediately when an error entry is appended"
    default y

config CAP_ACTIVITY_LOG_TASK_STACK
    int "Flush task stack size (bytes)"
    default 4096

endmenu
```

## components/claw_capabilities/cap_exec_state/Kconfig
```kconfig
menu "Claw Exec State Capability"

config CAP_EXEC_STATE_MAX_ENTRIES
    int "Maximum number of tracked entries"
    range 10 500
    default 200
    help
        Maximum number of execution-state entries kept in memory and on disk.
        When full, the least recently marked entry is evicted.

config CAP_EXEC_STATE_MAX_FILE_BYTES
    int "Maximum size of the persisted state file in bytes"
    range 4096 65535
    default 49152
    help
        Upper bound for the serialized state file. Oldest entries are evicted
        when the serialized JSON would exceed this budget.

config CAP_EXEC_STATE_FLUSH_DELAY_MS
    int "Deferred flush delay in milliseconds"
    range 0 60000
    default 2000
    help
        Delay between the first unsaved mark and the flush to storage. Marks
        arriving within the window are coalesced into one write. 0 flushes
        synchronously on every mark.

config CAP_EXEC_STATE_LIST_DEFAULT_LIMIT
    int "Default entry count returned by exec_state_list"
    range 1 500
    default 20

endmenu
```

## components/claw_capabilities/cap_proactive/Kconfig
```kconfig
menu "Proactive Pulse"
    config CAP_PROACTIVE_MIN_INTERVAL_SEC
        int "Minimum pulse interval (seconds)"
        range 60 86400
        default 300
    config CAP_PROACTIVE_MAX_INTERVAL_SEC
        int "Maximum pulse interval (seconds)"
        range 60 604800
        default 86400
    config CAP_PROACTIVE_DEFAULT_INTERVAL_SEC
        int "Default pulse interval (seconds)"
        range 60 604800
        default 900
endmenu
```

## components/claw_capabilities/cap_proactive/test_apps/proactive_test/sdkconfig.defaults
```kconfig
CONFIG_ESPTOOLPY_FLASHSIZE_4MB=y
CONFIG_PARTITION_TABLE_CUSTOM=y
CONFIG_PARTITION_TABLE_CUSTOM_FILENAME="partitions.csv"
CONFIG_FATFS_LFN_HEAP=y
CONFIG_FREERTOS_HZ=1000
CONFIG_ESP_TASK_WDT_EN=n
```

## components/common/led_status_indicator/Kconfig
```kconfig
menu "LED Status Indicator"

    config LED_STATUS_INDICATOR_ENABLE
        bool "Enable RGB LED status indicator"
        default y
        help
            Drive the onboard WS2812 RGB LED(s) to reflect device state
            (boot, idle, agent thinking, tool execution, Wi-Fi connectivity,
            errors, and one-shot notifications). Disable if the board has
            no addressable RGB LED wired up.

    config LED_STATUS_GPIO_NUM
        int "LED strip data GPIO"
        depends on LED_STATUS_INDICATOR_ENABLE
        default 48
        help
            GPIO driving the WS2812 data line. Defaults to the pin used by
            the board's single onboard RGB LED (see board_peripherals.yaml
            rmt_tx). N16R8 DevKitC-1 variants commonly wire this to GPIO48
            (older/other variants use GPIO38) — if the physical wiring
            differs, update this value.

    config LED_STATUS_LED_COUNT
        int "Number of LEDs on the strip"
        depends on LED_STATUS_INDICATOR_ENABLE
        default 1
        range 1 64
        help
            Number of WS2812 LEDs chained on LED_STATUS_GPIO_NUM. All LEDs
            are driven in sync with the same color/brightness. The stock
            ESP32-S3-DevKitC-1 (and clones) ship with a single onboard LED.

    config LED_STATUS_MAX_BRIGHTNESS
        int "Maximum LED brightness (0-255)"
        depends on LED_STATUS_INDICATOR_ENABLE
        default 60
        range 1 255
        help
            Brightness ceiling applied to every rendered color, to keep
            power draw and glare reasonable. Full WS2812 brightness (255)
            is very bright at close range.

endmenu
```
